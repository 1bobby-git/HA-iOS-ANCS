## components/ancs_app_resolver/Kconfig
```kconfig
menu "ANCS app name resolver"

config ANCS_APP_CACHE_CAPACITY
    int "Session app display name cache entries"
    default 16
    range 1 64

endmenu
```

## components/ancs_client/Kconfig
```kconfig
menu "ANCS client runtime"

config ANCS_REQUEST_TIMEOUT_MS
    int "Control Point response timeout (milliseconds)"
    default 3000
    range 1000 30000

config ANCS_WORKER_STACK_SIZE
    int "ANCS worker stack size"
    default 8192
    range 4096 16384

config ANCS_WORK_QUEUE_LENGTH
    int "BLE-to-worker queue length"
    default 24
    range 8 64

config ANCS_MAX_FRAGMENT_SIZE
    int "Maximum accepted Data Source fragment bytes"
    default 512
    range 64 1024

config ANCS_CACHE_CAPACITY
    int "Completed notification cache entries"
    default 4
    range 1 8

config ANCS_DUPLICATE_WINDOW_MS
    int "Exact Notification Source duplicate window"
    default 500
    range 100 5000

config ANCS_ENROLL_WINDOW_MS
    int "BLE enrollment advertising window (milliseconds)"
    default 120000
    range 10000 600000

config ANCS_ENROLL_BOOT_GPIO
    int "BOOT button GPIO used to open BLE enrollment"
    default 0 if IDF_TARGET_ESP32 || IDF_TARGET_ESP32S3
    default 28 if IDF_TARGET_ESP32C5
    default 9
    range 0 48

config ANCS_ENROLL_BOOT_HOLD_MS
    int "BOOT button hold time for BLE enrollment"
    default 3000
    range 500 30000

config ANCS_ENROLL_BUTTON_DEBOUNCE_MS
    int "BOOT button debounce interval"
    default 20
    range 5 250

endmenu
```

## components/ancs_protocol/Kconfig
```kconfig
menu "ANCS protocol limits"

config ANCS_APP_ID_MAX
    int "Maximum app identifier bytes"
    default 256
    range 32 1024

config ANCS_APP_NAME_MAX
    int "Maximum native app display name bytes"
    default 256
    range 32 1024

config ANCS_TITLE_MAX
    int "Maximum title bytes"
    default 512
    range 32 4096

config ANCS_SUBTITLE_MAX
    int "Maximum subtitle bytes"
    default 512
    range 32 4096

config ANCS_MESSAGE_MAX
    int "Maximum message bytes"
    default 4096
    range 128 16384

config ANCS_DATE_MAX
    int "Maximum date bytes"
    default 32
    range 16 128

config ANCS_REQUEST_QUEUE_CAPACITY
    int "Pending notification request capacity"
    default 16
    range 2 64

endmenu
```

## components/provision_store/Kconfig
```kconfig
menu "Provision store"

config PROVISION_STORE_TEST_BACKEND
    bool "Enable provision_store test backend"
    default n
    help
        Enables in-memory fault injection hooks for Unity tests. Keep disabled
        in production firmware so runtime code cannot switch away from NVS.

endmenu
```

## sdkconfig.defaults
```kconfig
CONFIG_IDF_TARGET="esp32c6"
CONFIG_ESPTOOLPY_FLASHSIZE_8MB=y
CONFIG_PARTITION_TABLE_CUSTOM=y
CONFIG_PARTITION_TABLE_CUSTOM_FILENAME="partitions.csv"
CONFIG_ESP_COEX_SW_COEXIST_ENABLE=y
CONFIG_MBEDTLS_CERTIFICATE_BUNDLE=y
CONFIG_BT_ENABLED=y
CONFIG_BT_BLUEDROID_ENABLED=y
# CONFIG_BT_NIMBLE_ENABLED is not set
CONFIG_BT_GATTS_ENABLE=y
CONFIG_BT_GATTC_ENABLE=y
CONFIG_BT_BLE_50_FEATURES_SUPPORTED=n
CONFIG_BT_BLE_42_FEATURES_SUPPORTED=y
CONFIG_BT_LE_50_FEATURE_SUPPORT=n
CONFIG_COMPILER_OPTIMIZATION_SIZE=y
CONFIG_ESP_CONSOLE_UART_DEFAULT=y
CONFIG_ESP_CONSOLE_UART_BAUDRATE=115200
CONFIG_LOG_DEFAULT_LEVEL_INFO=y
CONFIG_ANCS_APP_ID_MAX=256
CONFIG_ANCS_TITLE_MAX=512
CONFIG_ANCS_SUBTITLE_MAX=512
CONFIG_ANCS_MESSAGE_MAX=4096
CONFIG_ANCS_DATE_MAX=32
CONFIG_ANCS_REQUEST_QUEUE_CAPACITY=16
CONFIG_ANCS_REQUEST_TIMEOUT_MS=3000
CONFIG_ANCS_WORKER_STACK_SIZE=8192
CONFIG_ANCS_WORK_QUEUE_LENGTH=24
CONFIG_ANCS_MAX_FRAGMENT_SIZE=512
CONFIG_ANCS_CACHE_CAPACITY=4
CONFIG_ANCS_DUPLICATE_WINDOW_MS=500
```

## test_app/sdkconfig.defaults
```kconfig
CONFIG_IDF_TARGET="esp32c6"
CONFIG_ESPTOOLPY_FLASHSIZE_2MB=y
CONFIG_COMPILER_OPTIMIZATION_DEBUG=y
CONFIG_ESP_CONSOLE_UART_DEFAULT=y
CONFIG_ESP_CONSOLE_UART_BAUDRATE=115200
CONFIG_ESP_MAIN_TASK_STACK_SIZE=65536
CONFIG_PROVISION_STORE_TEST_BACKEND=y
```
